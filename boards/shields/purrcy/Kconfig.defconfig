## boards/shields/purrcy/Kconfig.defconfig
```kconfig
if SHIELD_PURRCY

config ZMK_KEYBOARD_NAME
    default "Purrcy"

endif

CONFIG_ZMK_USB_LOGGING=y
```

## config/boards/shields/purrcy/Kconfig.shield
```kconfig
# Copyright (c) 2024 naoyakadota
# SPDX-License-Identifier: MIT

config SHIELD_PURRCY
    def_bool $(shields_list_contains, purrcy)
```

## config/boards/shields/purrcy_left/Kconfig.defconfig
```kconfig
if SHIELD_PURRCY_LEFT

config ZMK_KEYBOARD_NAME
    default "purrcy_left"

endif
```

## config/boards/shields/purrcy_left/Kconfig.shield
```kconfig
config SHIELD_PURRCY_LEFT
    def_bool $(shields_list_contains, purrcy_left)

config SHIELD_PURRCY_LEFT
    def_bool $(shields_list_contains, purrcy_right)
```

## test/config/boards/shields/purrcy/Kconfig.defconfig
```kconfig
if SHIELD_PURRCY_LEFT

config ZMK_KEYBOARD_NAME
    default "Purrcy Left"

endif

if SHIELD_PURRCY_RIGHT
    default "Purrcy Right"
endif
```

## test/config/boards/shields/purrcy/Kconfig.shield
```kconfig
# Copyright (c) 2024 naoyakadota
# SPDX-License-Identifier: MIT

config SHIELD_PURRCY_LEFT
    def_bool $(shields_list_contains, purrcy_left)

config SHIELD_PURRCY_RIGHT
    def_bool $(shields_list_contains, purrcy_right)
```
